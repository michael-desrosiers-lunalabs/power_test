## build/Kconfig/boards/Kconfig
```kconfig
# Load Zephyr board Kconfig descriptions.
osource "C:/Users/MichaelDesrosiers/zephyrproject/zephyr/boards/nordic/nrf54l15dk/Kconfig"
```

## build/Kconfig/boards/Kconfig.defconfig
```kconfig
# Load Zephyr board defconfig descriptions.
osource "C:/Users/MichaelDesrosiers/zephyrproject/zephyr/boards/nordic/nrf54l15dk/Kconfig.defconfig"
```

## build/Kconfig/boards/Kconfig.nucleo_l476rg
```kconfig
# Load board Kconfig descriptions.
osource "C:/Users/MichaelDesrosiers/zephyrproject/zephyr/boards/st/nucleo_l476rg/Kconfig.nucleo_l476rg"
```

## build/Kconfig/boards/Kconfig.sysbuild
```kconfig
# Load Sysbuild board Kconfig descriptions.
osource "C:/Users/MichaelDesrosiers/zephyrproject/zephyr/boards/nordic/nrf54l15dk/Kconfig.sysbuild"
```
